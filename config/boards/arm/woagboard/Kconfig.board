## config/boards/arm/woagboard/Kconfig.board
```kconfig
# Copyright (c) 2020 The ZMK Contributors
# SPDX-License-Identifier: MIT

config WOAGBOARD_LEFT
    bool "Woagboard Left"
    depends on SOC_NRF52840_QIAA

config WOAGBOARD_RIGHT
    bool "Woagboard Right"
    depends on SOC_NRF52840_QIAA
```

## config/boards/arm/woagboard/Kconfig.defconfig
```kconfig
# Copyright (c) 2020 The ZMK Contributors
# SPDX-License-Identifier: MIT

if WOAGBOARD_LEFT

config ZMK_KEYBOARD_NAME
    default "Woagboard"

config ZMK_SPLIT_ROLE_CENTRAL
    default y

endif # WOAGBOARD_LEFT

if WOAGBOARD_LEFT || WOAGBOARD_RIGHT

config BOARD
	default "woagboard"

config ZMK_SPLIT
    default y

config BT_CTLR
	default BT

config ZMK_BLE
	default y

config NANOPB
	default ZMK_STUDIO_RPC

if USB

config USB_NRFX
	default y

config USB_DEVICE_STACK
	default y

endif # USB

endif
```

## config/west.yml
```yaml
manifest:
  remotes:
    - name: zmkfirmware
      url-base: https://github.com/zmkfirmware
  projects:
    - name: zmk
      remote: zmkfirmware
      revision: v02.1
      import: app/west.yml
  self:
    path: config
```
